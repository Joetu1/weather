## main/Kconfig.projbuild
```kconfig
menu "Weather Configuration"

config WIFI_SSID
    string "WiFi SSID"
	default "OnePlus3"
	help
		SSID (network name) for the Weather to connect to.

config WIFI_PASSWORD
    string "WiFi Password"
	default "Joetu12345"
	help
		WiFi password (WPA or WPA2) for the Weather to use.

		Can be left blank if the network has no security set.

endmenu
```
